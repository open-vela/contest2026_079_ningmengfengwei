## app/button_led/Kconfig
```kconfig
# apps/examples/button_led/Kconfig

config EXAMPLES_BUTTON_LED
	bool "openvela 桌宠按键与 LED"
	default n
	depends on EXAMPLES_CONTROL_CENTER
	---help---
	  K1 按键触发对话（替代唤醒词）+ LED 状态指示
```

## app/control_center/Kconfig
```kconfig
# apps/examples/control_center/Kconfig

config EXAMPLES_CONTROL_CENTER
	bool "openvela 桌宠控制中心"
	default n
	depends on LIB_CURL
	select NETUTILS_CJSON
	---help---
	  openvela 桌宠控制中心：HTTP 激活 + IPC 音频/文本分发（no-ws 精简版）

config EXAMPLES_CONTROL_CENTER_STACKSIZE
	int "control_center 栈大小(字节)"
	default 204800
	depends on EXAMPLES_CONTROL_CENTER
```

## app/lvgldemo/Kconfig
```kconfig
# apps/examples/lvgldemo/Kconfig

config EXAMPLES_LVGLDEMO
	bool "openvela 桌宠 GUI(lvgldemo)"
	default n
	depends on LVGL
	select LV_USE_NUTTX
	select LV_USE_NUTTX_TOUCHSCREEN
	select NETUTILS_CJSON
	---help---
	  openvela 桌宠 GUI：LVGL 显示表情/文字/状态，IPC 收 control_center 文本

config EXAMPLES_LVGLDEMO_STACKSIZE
	int "lvgldemo 栈大小(字节)"
	default 204800
	depends on EXAMPLES_LVGLDEMO
```
